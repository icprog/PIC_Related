///////////////////////////////////////////////////////////////////////
//                     GLCD - modified.C
//
//  How to use: 1. Create a new file in your CCS C library folder
//              titled 'GLCD - modified.C'
//              2. Copy all of the code from your 'GLCD.C' file to the
//              new 'GLCD - modified.C' file.
//              3. Paste the following code into the appropriate places
//              4. Replace all "output_D" with "output_B"
//              5. Replace all "input_D" with "input_B"
//
//  Why all this work?  The GLCD.C file is copyrighted Custom Computer
//  Services, so I cannot distribute the library to other individuals
//  unless they are licensed users of the CCS C compiler.  Sorry!
//
//  Version 1.1 08/21/2006
//              Steven Cholewiak (www.semifluid.com) modified the
//              code for operation with a PIC18F2550 by changing
//              control lines and changing the data port to Port B.
//              He also added a 3x5 font, which was based upon the
//              font format from http://instruct1.cit.cornell.edu/
//              courses/ee476/video/Video32v2.c and modified to
//              include characters defined from http://mckoss.com/
//              jscript/tinyalice.htm
///////////////////////////////////////////////////////////////////////


//================================
// Paste in the top of your 'GLCD - modified.C' file!
//================================
#define GLCD_DI  PIN_C0   // Data or Instruction input
#define GLCD_RW  PIN_C1   // Read/Write
#define GLCD_E   PIN_C2   // Enable
#define GLCD_CS1 PIN_A3   // Chip Selection 1
#define GLCD_CS2 PIN_A4   // Chip Selection 2
#define GLCD_RST PIN_A5   // Reset

//================================
// Paste above "const int8 TEXT[51][5]"
//================================
//3x5 Font packed two per definition
//Original format from http://instruct1.cit.cornell.edu/courses/ee476/video/Video32v2.c
// - Modified by Steven Cholewiak (www.semifluid.com)
//    - 08/08/06 - Included punctuation characters
const int8 TEXT35[95][5]={
   0b00000000,	0b00000000,	0b00000000,	0b00000000,	0b00000000, //SPACE
   0b01000100,	0b01000100,	0b01000100,	0b00000000,	0b01000100, //!
   0b10101010,	0b10101010,	0b00000000,	0b00000000,	0b00000000, //"
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	0b00000000,	0b11001100,	0b10101010,	0b00000000,	0b00000000  //~
	};

//================================
// Paste above "glcd_fillScreen(int1 color)"
//================================
// Purpose:       Write small text on a graphic LCD
// Inputs:        (x,y) - The upper left coordinate of the first letter
//                textptr - A pointer to an array of text to display
//                color - ON or OFF

//char characterSet[] = " !#$%&'()*+,-./0123456789:;<=>?@ABCDEFGHIJKLMNOPQRSTUVWXYZ[\\]^_`abcdefghijklmnopqrstuvwxyz{|}~";
void glcd_text35(int8 x, int8 y, char* textptr, int1 color)
{
   int i, j, k;                           // Loop counters
   BYTE pixelData[5];                     // Stores character data

   for(i=0; textptr[i] != '\0'; ++i, ++x) // Loop through the passed string
   {
      if((textptr[i] >= ' ') && (textptr[i] <= '~'))
         memcpy(pixelData, TEXT35[textptr[i]-' '], 5);
      else
         memcpy(pixelData, TEXT35[0], 5); // Default to space

      if(x+3 >= GLCD_WIDTH)          // Performs character wrapping
      {
         x = 0;                           // Set x at far left position
         y += 5 + 1;                      // Set y at next position down
      }
      for(j=3; j>0; j--, x++)             // Loop through character byte data
      {
         for(k=0; k<5; k++)               // Loop through the vertical pixels
         {
            if(bit_test(pixelData[k], j)) // Check if the pixel should be set
            {
               glcd_pixel(x, y+k, color); // Draws the pixel
            }
         }
      }
   }
}
